#include <TensorFlowLite.h>

#include <TensorFlowLite.h>

#include <TensorFlowLite.h>
#include "network_model.h"
#include "tensorflow/lite/micro/kernels/micro_ops.h"
#include "tensorflow/lite/micro/micro_error_reporter.h"
#include "tensorflow/lite/micro/micro_interpreter.h"
#include "tensorflow/lite/micro/micro_mutable_op_resolver.h"
#include "tensorflow/lite/schema/schema_generated.h"
#include "tensorflow/lite/version.h"

#define NUMBER_OF_INPUTS 50
#define NUMBER_OF_OUTPUTS 1
#define TENSOR_ARENA_SIZE 100*1024

uint8_t tensor_arena[TENSOR_ARENA_SIZE];
tflite::ErrorReporter* error_reporter;
tflite::MicroInterpreter* interpreter;
TfLiteTensor* input;
TfLiteTensor* output;

int total_samples;
int correct_count;

const float X_test[40][50] = {
    -1.0484968788074953, -1.037732778547195, -1.0200785678510247, 
    -0.9430446365306423, -1.0683513036557821, 1.2354582258902493, 
    1.2492563571403474, -1.0840699590221563, -1.1195143963958516, 
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    0.33767971482649434, 0.24908739943044733
};

const uint8_t y_test[40] = {
    1, 0, 1, 0, 1, 0, 0, 1, 0, 0, 1, 0, 0, 0, 0, 1, 1, 0, 0, 1, 0, 1, 0, 0, 0, 
    1, 0, 1, 0, 1, 1, 1, 0, 0, 1, 0, 0, 0, 1, 0
};

void setup() {
    Serial.begin(115200);
    static tflite::MicroErrorReporter micro_error_reporter;
    error_reporter = &micro_error_reporter;

    const tflite::Model* model = tflite::GetModel(network_model);
    if (model->version() != TFLITE_SCHEMA_VERSION) {
        Serial.println("Model version does not match schema version.");
        return;
    }

    static tflite::MicroMutableOpResolver<10> micro_op_resolver;
    micro_op_resolver.AddFullyConnected();
    micro_op_resolver.AddSoftmax();
    micro_op_resolver.AddQuantize();
    micro_op_resolver.AddDequantize();

    static tflite::MicroInterpreter static_interpreter(model, micro_op_resolver, tensor_arena, TENSOR_ARENA_SIZE, error_reporter);
    interpreter = &static_interpreter;

    if (interpreter->AllocateTensors() != kTfLiteOk) {
        Serial.println("Failed to allocate tensors!");
        return;
    }

    input = interpreter->input(0);
    output = interpreter->output(0);
}

void loop() {
    total_samples = 0;
    correct_count = 0;

    for (uint8_t i = 0; i < 40; i++) {

        total_samples++;

        // Load the i-th test sample data into the input tensor
        for (int j = 0; j < NUMBER_OF_INPUTS; j++) {
            input->data.f[j] = X_test[i][j];
        }

        // Run the model on this input and check for error
        // interpreter->Invoke();
        if (interpreter->Invoke() != kTfLiteOk) {
             Serial.println("Failed to invoke!");
             continue;
        }

        float prediction = output->data.f[0];
        int predicted_class = (prediction > 0.5) ? 0 : 1;

        Serial.print("Sample #");
        Serial.print(i + 1);

        if (predicted_class == 0) {
          Serial.print(", Predicted Class: normal");
        } else {
          Serial.print(", Predicted Class: trigger");
        }

        if (y_test[i] == 0) {
          Serial.println(", Actual Class: normal");
        } else {
          Serial.println(", Actual Class: trigger");
        }

        if (predicted_class == y_test[i]) {
          correct_count++;
        }
        
        // Delay between predictions
        delay(1000);
    }
    Serial.println();
    Serial.println();
    Serial.println("Accuracy Evaluation: ");
    Serial.print("Total number of input samples: ");
    Serial.println(total_samples);
    Serial.print("Total number of samples correctly classified: ");
    Serial.println(correct_count);

    float accuracy = (1.0 * correct_count) /  total_samples;

    Serial.print("Model accuracy: ");
    Serial.println(accuracy);

    Serial.println();
    Serial.println();

    // Delay before repeating the tests
    delay(10000);
}
